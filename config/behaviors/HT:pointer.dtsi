#ifndef HT_POINTER_DTSI
#define HT_POINTER_DTSI

#include <behaviors.dtsi>
#include <dt-bindings/zmk/keys.h>
#include <dt-bindings/zmk/pointing.h>

/ {
    behaviors {
        mt_mouse: pointer_tap_hold {
            compatible = "zmk,behavior-hold-tap";
            label = "MOUSE_TAP_HOLD";
            flavor = "tap-preferred";
            bindings = <&mmv>, <&kp>;
            #binding-cells = <2>;
            tapping-term-ms = <200>;
            quick-tap-ms = <150>;
        };
    };
};

#endif