#ifndef MM_SMART_SHIFT_DTSI
#define MM_SMART_SHIFT_DTSI

#include <behaviors.dtsi>
#include <dt-bindings/zmk/keys.h>

/ {
    behaviors {
        smart_shift: smart_shift {
            compatible = "zmk,behavior-mod-morph";
            label = "SMART_SHIFT";
            bindings = <&sk LEFT_SHIFT>, <&caps_word>;
            #binding-cells = <0>;
            mods = <MOD_LSFT>;
        };
    };
};

#endif
