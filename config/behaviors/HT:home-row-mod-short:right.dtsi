#ifndef HT_HOME_ROW_MOD_SHORT_RIGHT_DTSI
#define HT_HOME_ROW_MOD_SHORT_RIGHT_DTSI

#include <behaviors.dtsi>
#include <dt-bindings/zmk/keys.h>

// Key position groups for home row mods
#define KEYS_L 0 1 2 3 4 10 11 12 13 14 20 21 22 23 24  

#ifdef IS_CHARYBDIS
    #define THUMBS 30 31 32 33 34 35
#else
    #define THUMBS 30 31 32 33 34 35 36
#endif

/ {
    behaviors {
        hmr_s: homerow_mods_right_short {
            compatible = "zmk,behavior-hold-tap";
            label = "HOMEROW_MODS_RIGHT_SHORT";
            bindings = <&kp>, <&kp>;
            #binding-cells = <2>;
            flavor = "balanced";
            tapping-term-ms = <280>;
            require-prior-idle-ms = <0>;
            quick-tap-ms = <150>;
            hold-trigger-on-release;
            hold-trigger-key-positions = <KEYS_L THUMBS>;
        };
    };
};

#endif
