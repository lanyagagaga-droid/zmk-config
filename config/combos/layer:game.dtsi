#include <behaviors.dtsi>
#include <dt-bindings/zmk/keys.h>
#include <dt-bindings/zmk/pointing.h>

#define GAME 5

/ {
    combos {

        combo_game {
            key-positions = <5 9>;
            bindings = <&to GAME>;
        };
    };
};

