#include <behaviors.dtsi>
#include <dt-bindings/zmk/keys.h>

/ {
    combos {
        combo_unlock {
            key-positions = <0 4>;              // / B (Colemak) / B Z (Graphite)
            bindings = <&studio_unlock>;
        };
    };
};

