#include <behaviors.dtsi>
#include <dt-bindings/zmk/keys.h>

/ {
    keymap {
        Reset {
          display-name = "Reset";
          bindings = <
            &none &none &none &none &none              &none &none &none &none &none     
            &none &none &none &none &none              &none &none &none &none &none    
            &none &none &none &none &none              &none &none &none &none &none
                        &none &none &bootloader        &bootloader &none               
        
                                            #ifndef IS_CHARYBDIS
                                                 &none
                                            #endif
          >;
        };
    };
};
