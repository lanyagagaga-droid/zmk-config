

// Behaviors
// Behaviors are now included in their respective layer files

// Macros
#include "macros/pointer-right-alt.dtsi"
#include "macros/pointer-left-ctrl.dtsi"
#include "macros/pointer-down-shift.dtsi"

// Combos
#include "combos/modded-key:ctrl-delete.dtsi"
#include "combos/key:escape.dtsi"
#include "combos/key:tab.dtsi"
#include "combos/layer:functions.dtsi"
#include "combos/layer:graphite.dtsi"
#include "combos/reset:left.dtsi"
#include "combos/reset:right.dtsi"
#include "combos/unlock.dtsi"
#include "combos/expand.dtsi"

// Layers
#include "layers/base.dtsi"
#include "layers/graphite.dtsi"
#include "layers/symbols.dtsi"
#include "layers/numbers.dtsi"
#include "layers/functions.dtsi"
#include "behaviors/globals.dtsi"

/ {
  chosen { 
    zmk,physical-layout = &foostan_corne_5col_layout; 
  };

  keymap {
    compatible = "zmk,keymap";
  };
};


