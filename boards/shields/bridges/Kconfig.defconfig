## boards/shields/bridges/Kconfig.defconfig
```kconfig
# Copyright (c) 2025 Vincent Franco
# SPDX-License-Identifier: MIT

if SHIELD_BRIDGES_DONGLE

config ZMK_KEYBOARD_NAME
	default "Bridges"

config ZMK_SPLIT_ROLE_CENTRAL
	default y

endif

if SHIELD_BRIDGES_DONGLE || SHIELD_BRIDGES_LEFT || SHIELD_BRIDGES_RIGHT

config ZMK_SPLIT
	default y

endif

config IS_BRIDGES
  bool
  default y
```

## boards/shields/bridges/Kconfig.shield
```kconfig
config SHIELD_BRIDGES_LEFT
  def_bool $(shields_list_contains,bridges_left)

config SHIELD_BRIDGES_RIGHT
  def_bool $(shields_list_contains,bridges_right)

config SHIELD_BRIDGES_DONGLE
  def_bool $(shields_list_contains,bridges_dongle)
```

## config/west.yml
```yaml
manifest:
  remotes:
    - name: zmkfirmware
      url-base: https://github.com/zmkfirmware
    - name: badjeff
      url-base: https://github.com/badjeff
    - name: minhe7735 
      url-base: https://github.com/minhe7735
    - name: carrefinho
      url-base: https://github.com/carrefinho
  projects:
    - name: zmk
      remote: zmkfirmware
      revision: main
      import: app/west.yml
    - name: zmk-pmw3610-driver
      remote: badjeff
      revision: main
    - name: prospector-zmk-module
      remote: carrefinho 
      revision: core/zephyr-4-1
    - name: text-expander
      remote: minhe7735
      revision: dev
  self:
    path: config
```
